## Kconfig
```kconfig
# Copyright (c) 2024 The ZMK Contributors
# SPDX-License-Identifier: MIT

DT_COMPAT_DRV883X := ti,drv883x

config DRV883X
  bool "DRV883X haptic motor driver"
  default $(dt_compat_enabled,$(DT_COMPAT_DRV883X))
  select PWM
  help
      Enable DRV883X haptic motor driver.

if DRV883X

DT_COMPAT_ZMK_BEHAVIOR_DRV883X := zmk,behavior-drv883x
config ZMK_BEHAVIOR_DRV883X
    bool
    default $(dt_compat_enabled,$(DT_COMPAT_ZMK_BEHAVIOR_DRV883X))

module = DRV883X
module-str = DRV883X
source "${ZEPHYR_BASE}/subsys/logging/Kconfig.template.log_config"

endif #DRV883X
```

## dts/bindings/ti,drv883x.yml
```yaml
# Copyright (c) 2024 The ZMK Contributors
# SPDX-License-Identifier: MIT

description: |
  Sensor driver for the DRV883x Motor Driver

compatible: "ti,drv883x"

include: [base.yaml, pinctrl-device.yaml]

properties:
  enable-gpios:
    type: phandle-array
  pwms:
    type: phandle-array
    description: PWM specifier driving the output.
  in1-gpios:
    type: phandle-array
  in2-gpios:
    type: phandle-array
```

## dts/bindings/zmk,behavior-drv883x.yaml
```yaml
description: HID IO key press behavior

compatible: "zmk,behavior-drv883x"

include: two_param.yaml

properties:
  drv883x-dev:
    type: phandle
    required: true
  vel-neutral:
    type: int
    default: 128
  vel-min-max:
    type: int
    default: 128
```
